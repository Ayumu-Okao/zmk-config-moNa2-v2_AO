## config/west.yml
```yaml
manifest:
  remotes:
    - name: zmkfirmware
      url-base: https://github.com/zmkfirmware
    - name: sayu-hub
      url-base: https://github.com/sayu-hub
    - name: badjeff    # <-- PMW3610
      url-base: https://github.com/badjeff
    - name: caksoylar  # <-- RGB LED
      url-base: https://github.com/caksoylar  
    - name: zettaface  # <-- Input Processor Keybind
      url-base: https://github.com/zettaface
  projects:
    - name: zmk
      remote: zmkfirmware
      revision: v0.3.0
      import: app/west.yml
    - name: zmk-pmw3610-driver
      remote: badjeff
      revision: zmk-0.3
    - name: zmk-rgbled-widget
      remote: caksoylar
      revision: main
    - name: zmk-input-processor-keybind
      remote: zettaface
      revision: main
    # ★ここを badjeff 版に変更（認証エラー回避）
    - name: zmk-input-behavior-listener
      remote: badjeff
      revision: main
  self:
    path: config
```
